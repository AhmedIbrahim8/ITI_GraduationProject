# file: Simple_Autonomous_Arm_Keil.ioc
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Mcu.Family=STM32F4
Mcu.Name=STM32F401C(B-C)Ux
Mcu.Package=UFQFPN48
NVIC.PriorityGroup=NVIC_PRIORITYGROUP_4
ProjectManager.HeapSize=0x200
ProjectManager.StackSize=0x400
ProjectManager.TargetToolchain=MDK-ARM V5.32
RCC.AHBFreq_Value=16000000
RCC.APB1Freq_Value=16000000
RCC.APB2Freq_Value=16000000
RCC.CortexFreq_Value=16000000
RCC.HSE_VALUE=25000000
RCC.HSI_VALUE=16000000
RCC.LSE_VALUE=32768
RCC.SYSCLKFreq_VALUE=16000000
RCC.VCOOutputFreq_Value=192000000
board=custom

// file: Core/Src/main.c
/* USER CODE BEGIN Header */
/**
  ******************************************************************************
  * @file           : main.c
  * @brief          : Main program body
  ******************************************************************************
  * @attention
  *
  * Copyright (c) 2023 STMicroelectronics.
  * All rights reserved.
  *
  * This software is licensed under terms that can be found in the LICENSE file
  * in the root directory of this software component.
  * If no LICENSE file comes with this software, it is provided AS-IS.
  *
  ******************************************************************************
  */
/* USER CODE END Header */
#include "main.h"

/* USER CODE BEGIN Includes */

#include "STD_Types.h"
#include "BIT_MATH.h"

#include "DCM_Interface.h"

#include "GPT_Interface.h"

#include "Ultrasonic_Interface.h"

#include "SERVO_Interface.h"

#include "App.h"

/* USER CODE END Includes */

/* USER CODE BEGIN PD */
u32 DistanceForward = 0;
u32 DistanceRight = 0;
u32 DistanceLeft = 0;

/* USER CODE END PD */

void SystemClock_Config(void);

int main(void)
{

  /* MCU Configuration--------------------------------------------------------*/

  /* Reset of all peripherals, Initializes the Flash interface and the Systick. */
  HAL_Init();

  /* Configure the system clock */
  SystemClock_Config();

  /* Initialize all configured peripherals */
  /* USER CODE BEGIN 2 */
	/* Peripheral Enable Clock */
	Peripheral_EnableClock();

	DCM_Init(Configuration);

	Servo_Init();

	UltraSonic_Init();

	TIMER_Init(&Timer5_configuration);

	SERVO_SET_DIRECTION(SERVO_DIRECTION_FORWARD);
	TIMER_DelayMS(TIMER5_SELECTION,500);
  /* USER CODE END 2 */

  /* Infinite loop */
  while (1)
  {

    /* USER CODE BEGIN 3 */
		UltraSonic_Send_Pulse();
		DistanceForward=UltraSonic_Measure_Distance();
		while(DistanceForward < 70)
		{
			App_CarStop();

			UltraSonic_Send_Pulse();
			DistanceForward=UltraSonic_Measure_Distance();

			SERVO_SET_DIRECTION(SERVO_DIRECTION_RIGHT);
			TIMER_DelayMS(TIMER5_SELECTION,1000);

			UltraSonic_Send_Pulse();
			DistanceRight=UltraSonic_Measure_Distance();

			SERVO_SET_DIRECTION(SERVO_DIRECTION_LEFT);
			TIMER_DelayMS(TIMER5_SELECTION,1000);

			UltraSonic_Send_Pulse();
			DistanceLeft=UltraSonic_Measure_Distance();

			SERVO_SET_DIRECTION(SERVO_DIRECTION_FORWARD);
			TIMER_DelayMS(TIMER5_SELECTION,1000);

			UltraSonic_Send_Pulse();
			DistanceForward=UltraSonic_Measure_Distance();

			if(DistanceForward >70){
				break;
			}
			else if(DistanceRight>DistanceLeft && DistanceRight>70)
			{
				App_CarMoveRight(60);
				TIMER_DelayMS(TIMER5_SELECTION,400);/////////////////////////
			}
			else if(DistanceLeft>DistanceRight && DistanceLeft>70)
			{
				App_CarMoveLeft(60);
				TIMER_DelayMS(TIMER5_SELECTION,400);/////////////////////////
			}

		}

		UltraSonic_Send_Pulse();
		DistanceForward=UltraSonic_Measure_Distance();
		while(DistanceForward > 70){
			UltraSonic_Send_Pulse();
			DistanceForward=UltraSonic_Measure_Distance();
			App_CarMoveForward(25);
		}

  }
  /* USER CODE END 3 */
}

void SystemClock_Config(void)
{
  RCC_OscInitTypeDef RCC_OscInitStruct = {0};
  RCC_ClkInitTypeDef RCC_ClkInitStruct = {0};

  /** Configure the main internal regulator output voltage
  */
  __HAL_RCC_PWR_CLK_ENABLE();
  __HAL_PWR_VOLTAGESCALING_CONFIG(PWR_REGULATOR_VOLTAGE_SCALE2);

  /** Initializes the RCC Oscillators according to the specified parameters
  * in the RCC_OscInitTypeDef structure.
  */
  RCC_OscInitStruct.OscillatorType = RCC_OSCILLATORTYPE_HSI;
  RCC_OscInitStruct.HSIState = RCC_HSI_ON;
  RCC_OscInitStruct.HSICalibrationValue = RCC_HSICALIBRATION_DEFAULT;
  RCC_OscInitStruct.PLL.PLLState = RCC_PLL_NONE;
  if (HAL_RCC_OscConfig(&RCC_OscInitStruct) != HAL_OK)
  {
    Error_Handler();
  }

  /** Initializes the CPU, AHB and APB buses clocks
  */
  RCC_ClkInitStruct.ClockType = RCC_CLOCKTYPE_HCLK|RCC_CLOCKTYPE_SYSCLK
                              |RCC_CLOCKTYPE_PCLK1|RCC_CLOCKTYPE_PCLK2;
  RCC_ClkInitStruct.SYSCLKSource = RCC_SYSCLKSOURCE_HSI;
  RCC_ClkInitStruct.AHBCLKDivider = RCC_SYSCLK_DIV1;
  RCC_ClkInitStruct.APB1CLKDivider = RCC_HCLK_DIV1;
  RCC_ClkInitStruct.APB2CLKDivider = RCC_HCLK_DIV1;

  if (HAL_RCC_ClockConfig(&RCC_ClkInitStruct, FLASH_LATENCY_0) != HAL_OK)
  {
    Error_Handler();
  }
}

void Error_Handler(void)
{
  __disable_irq();
  while (1)
  {
  }
}
